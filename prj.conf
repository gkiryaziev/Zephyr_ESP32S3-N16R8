## CMakeLists.txt
```
cmake_minimum_required(VERSION 3.20.0)

find_package(Zephyr REQUIRED HINTS $ENV{ZEPHYR_BASE})

project(Zephyr_ESP32S3-N16R8)

target_sources(app PRIVATE src/main.c)
```

## prj.conf
```kconfig
# PSRAM and FLASH
CONFIG_ESP_SPIRAM=y
CONFIG_SPIRAM_MODE_OCT=y
CONFIG_ESPTOOLPY_FLASHMODE_QIO=y
# CONFIG_SPIRAM_SPEED_80M=y
# CONFIG_ESPTOOLPY_FLASHFREQ_80M=y
```

## esp32s3_devkitc.overlay
```dts
/* 8MB PSRAM */
&psram0 {
	size = <DT_SIZE_M(8)>;
};

/* 16MB FLASH */
&flash0 {
	/delete-node/ partitions;
};

&flash0 {
	reg = <0x0 DT_SIZE_M(16)>;
};

#include <espressif/partitions_0x0_amp_16M.dtsi>
/* --------- */
```

## src/main.c
```c
#include <zephyr/kernel.h>
#include <zephyr/sys/printk.h>

int main(void)
{
    while (1) {
        printk("Hello World!\n");
        k_msleep(1000);
    }

    return 0;
}
```
